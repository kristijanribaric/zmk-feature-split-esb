## dts/bindings/zmk,split-esb.yaml
```yaml
# Copyright 2026 Roman Kuzmitskii (@damex)
# SPDX-License-Identifier: MIT

description: |
  Shared ESB link identity for a single-peripheral ZMK ESB split. The central and
  the peripheral must declare identical values to pair. Place this node in a dtsi
  included by both sides.

compatible: "zmk,split-esb"

properties:
  base-address:
    type: uint8-array
    required: true
    description: 4-byte ESB base address for pipe 0.
  prefix:
    type: int
    required: true
    description: 1-byte address prefix for pipe 0.
  rf-channel:
    type: int
    required: true
    description: RF channel, 2400 + N MHz (0-100).
  lossy-codes:
    type: array
    description: |
      Input axes the peripheral sends without ACK. Each entry is two cells, an
      INPUT_EV_* type and its INPUT_*_<NAME> code, e.g. <INPUT_EV_REL INPUT_REL_X>,
      <INPUT_EV_REL INPUT_REL_Y>. Reserve for high-rate, self-correcting axes
      (pointer motion); buttons, wheel detents, SYN markers, sensor and battery
      events stay ACK'd regardless. Omit for fully lossless link.
```

## west.yml
```yaml
# Copyright 2026 Roman Kuzmitskii (@damex)
# SPDX-License-Identifier: MIT

manifest:
  remotes:
    - name: nrfconnect
      url-base: https://github.com/nrfconnect

  projects:
    - name: sdk-nrf
      remote: nrfconnect
      revision: v3.1.1
      path: nrf

    - name: nrfxlib
      remote: nrfconnect
      repo-path: sdk-nrfxlib
      revision: v3.1.1
      path: nrfxlib

    - name: mbedtls
      remote: nrfconnect
      repo-path: sdk-mbedtls
      revision: ncs-v3.1.1
      path: modules/crypto/mbedtls

    - name: oberon-psa-crypto
      remote: nrfconnect
      repo-path: sdk-oberon-psa-crypto
      revision: ncs-v3.1.1
      path: modules/crypto/oberon-psa-crypto
```
